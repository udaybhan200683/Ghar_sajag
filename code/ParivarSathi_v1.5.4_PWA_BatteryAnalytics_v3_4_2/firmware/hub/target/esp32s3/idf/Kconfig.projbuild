## code/ParivarSathi_v1.5.4_PWA_BatteryAnalytics_v3_4_2/firmware/hub/target/esp32s3/idf/Kconfig.projbuild
```kconfig
menu "Ghar Sajag S3 storage lifecycle"

config GS_OUTBOX_BODY_RETIREMENT_ENABLED
    bool "Enable event body retirement requests"
    default n
    help
        Enables the outbox lifecycle retirement code path. Keep disabled until
        the product post-sync retention policy and physical recovery behavior
        are qualified. A separate runtime retention-satisfied authorization,
        backend completion and an authenticated Node retirement report are
        still required for any deletion.

endmenu
```

## code/ParivarSathi_v1.5.4_PWA_BatteryAnalytics_v3_4_2/host/storage/nvs_runtime_probe/sdkconfig.defaults
```kconfig
CONFIG_IDF_TARGET="linux"
CONFIG_PARTITION_TABLE_CUSTOM=y
CONFIG_PARTITION_TABLE_CUSTOM_FILENAME="partitions.csv"
CONFIG_PARTITION_TABLE_FILENAME="partitions.csv"
CONFIG_PARTITION_TABLE_OFFSET=0x8000
CONFIG_ESP_PARTITION_ENABLE_STATS=y
```

## code/firmware/hub/target/esp32s3/idf/Kconfig.projbuild
```kconfig
menu "Ghar Sajag S3 storage lifecycle"

config GS_OUTBOX_BODY_RETIREMENT_ENABLED
    bool "Enable event body retirement requests"
    default n
    help
        Enables the outbox lifecycle retirement code path. Keep disabled until
        the product post-sync retention policy and physical recovery behavior
        are qualified. A separate runtime retention-satisfied authorization,
        backend completion and an authenticated Node retirement report are
        still required for any deletion.

config GS_IDENTITY_COMPACTION_ENABLED
    bool "Enable durable identity compaction and deletion"
    default n
    help
        Keep disabled until replay-fence and identity-generation cutover are
        power-cut qualified on physical S3 LittleFS and retention approval is
        recorded. Host tests do not enable firmware deletion.

endmenu
```

## code/firmware/hub/target/esp32s3/idf/sdkconfig.defaults
```kconfig
CONFIG_ESPTOOLPY_FLASHSIZE_16MB=y
CONFIG_ESPTOOLPY_FLASHMODE_DIO=y
CONFIG_ESPTOOLPY_FLASHFREQ_40M=y
CONFIG_PARTITION_TABLE_CUSTOM=y
CONFIG_PARTITION_TABLE_CUSTOM_FILENAME="partitions.development.csv"
CONFIG_BOOTLOADER_APP_ROLLBACK_ENABLE=y
CONFIG_COMPILER_OPTIMIZATION_SIZE=y
CONFIG_SPIRAM=y
CONFIG_SPIRAM_MODE_OCT=y
CONFIG_SPIRAM_SPEED_40M=y
CONFIG_SPIRAM_BOOT_INIT=y
CONFIG_SPIRAM_MEMTEST=y
CONFIG_SPIRAM_USE_CAPS_ALLOC=y
# CONFIG_SPIRAM_IGNORE_NOTFOUND is not set
# CONFIG_SPIRAM_ALLOW_BSS_SEG_EXTERNAL_MEMORY is not set
# CONFIG_SPIRAM_FETCH_INSTRUCTIONS is not set
# CONFIG_SPIRAM_RODATA is not set
# CONFIG_FREERTOS_TASK_CREATE_ALLOW_EXT_MEM is not set
```

## code/tools/factory/esp32_init/sdkconfig.defaults
```kconfig
CONFIG_ESPTOOLPY_FLASHSIZE_4MB=y
CONFIG_PARTITION_TABLE_CUSTOM=y
CONFIG_BOOTLOADER_APP_ROLLBACK_ENABLE=y
CONFIG_COMPILER_OPTIMIZATION_SIZE=y
CONFIG_ESP_MAIN_TASK_STACK_SIZE=20480
CONFIG_COMPILER_CXX_EXCEPTIONS=y
```
